## components/infrastructure/Kconfig.projbuild
```kconfig
menu "MQTT Configuration"

    config MQTT_BROKER_URI
        string "MQTT Broker URI"
        default "mqtt://mqtt.liwaisi.tech:1883"
        help
            URI of the MQTT broker. Supports multiple protocols:
            - Standard MQTT: mqtt://hostname:port
            - MQTT over WebSocket: ws://hostname:port/path
            - Secure MQTT: mqtts://hostname:port
            - Secure WebSocket: wss://hostname:port/path
            
            Examples:
            - mqtt://192.168.1.100:1883 (standard MQTT)
            - ws://mqtt.iot.liwaisi.tech:80/mqtt (WebSocket MQTT)
            - mqtts://secure-broker.com:8883 (secure MQTT)

    config MQTT_CLIENT_ID_PREFIX
        string "MQTT Client ID Prefix"
        default "liwaisi_sis"
        help
            Prefix for MQTT client ID. The full client ID will be:
            <prefix>_<last_3_MAC_bytes>
            Example: liwaisi_sis_A1B2C3

    config MQTT_REGISTRATION_TOPIC
        string "Device Registration Topic"
        default "/liwaisi/iot/smart-irrigation/device/registration"
        help
            MQTT topic for publishing device registration messages.
            This topic is used when the device connects to announce
            its presence and current network information.

    config MQTT_SENSOR_DATA_TOPIC
        string "Sensor Data Topic"
        default "/liwaisi/iot/smart-irrigation/sensors/temperature-and-humidity"
        help
            MQTT topic for publishing sensor data messages.
            This topic is used to send temperature and humidity
            sensor readings to the IoT platform.

    config MQTT_KEEPALIVE_SECONDS
        int "MQTT Keep Alive Interval (seconds)"
        range 30 300
        default 60
        help
            MQTT keep-alive interval in seconds. This determines
            how often the client sends ping messages to keep
            the connection active.

    config MQTT_QOS_LEVEL
        int "MQTT QoS Level for Registration Messages"
        range 0 2
        default 1
        help
            Quality of Service level for device registration messages:
            0 = At most once (fire and forget)
            1 = At least once (acknowledged delivery)
            2 = Exactly once (guaranteed delivery)

    config MQTT_RECONNECT_INITIAL_DELAY_MS
        int "Initial reconnection delay (milliseconds)"
        range 1000 60000
        default 30000
        help
            Initial delay before attempting reconnection after
            connection failure. Uses exponential backoff.

    config MQTT_RECONNECT_MAX_DELAY_MS
        int "Maximum reconnection delay (milliseconds)"
        range 60000 7200000
        default 3600000
        help
            Maximum delay between reconnection attempts.
            Default is 1 hour (3600000 ms).

    config MQTT_ENABLE_DEBUG_LOGS
        bool "Enable verbose MQTT debug logs"
        default n
        help
            Enable detailed debug logging for MQTT operations.
            This can help with troubleshooting but may increase
            log verbosity significantly.

    config MQTT_ADAPTER_TASK_STACK_SIZE
        int "MQTT Adapter Task Stack Size (bytes)"
        range 4096 16384
        default 8192
        help
            Stack size for MQTT client task. Increase if you
            encounter stack overflow issues.

    config MQTT_ADAPTER_BUFFER_SIZE
        int "MQTT Adapter Buffer Size (bytes)"
        range 1024 8192
        default 2048
        help
            Size of buffer for MQTT messages. Must be large enough
            to hold the largest expected message.

endmenu
```

## components/infrastructure/adapters/mqtt_adapter/Kconfig
```kconfig
menu "MQTT Configuration"

    config MQTT_BROKER_URI
        string "MQTT Broker WebSocket URI"
        default "ws://mqtt.iot.liwaisi.tech:80/mqtt"
        help
            WebSocket URI of the MQTT broker (NATS server with MQTT compatibility).
            Format: ws://hostname:port/path
            Default connects to Liwaisi's NATS server with MQTT interface.

    config MQTT_CLIENT_ID_PREFIX
        string "MQTT Client ID Prefix"
        default "ESP32"
        help
            Prefix for MQTT client ID. The full client ID will be:
            <prefix>_<last_3_MAC_bytes>
            Example: ESP32_A1B2C3

    config MQTT_REGISTRATION_TOPIC
        string "Device Registration Topic"
        default "/liwaisi/iot/smart-irrigation/device/registration"
        help
            MQTT topic for publishing device registration messages.
            This topic is used when the device connects to announce
            its presence and current network information.

    config MQTT_KEEPALIVE_SECONDS
        int "MQTT Keep Alive Interval (seconds)"
        range 30 300
        default 60
        help
            MQTT keep-alive interval in seconds. This determines
            how often the client sends ping messages to keep
            the connection active.

    config MQTT_QOS_LEVEL
        int "MQTT QoS Level for Registration Messages"
        range 0 2
        default 1
        help
            Quality of Service level for device registration messages:
            0 = At most once (fire and forget)
            1 = At least once (acknowledged delivery)
            2 = Exactly once (guaranteed delivery)

    config MQTT_RECONNECT_INITIAL_DELAY_MS
        int "Initial reconnection delay (milliseconds)"
        range 1000 60000
        default 30000
        help
            Initial delay before attempting reconnection after
            connection failure. Uses exponential backoff.

    config MQTT_RECONNECT_MAX_DELAY_MS
        int "Maximum reconnection delay (milliseconds)"
        range 60000 7200000
        default 3600000
        help
            Maximum delay between reconnection attempts.
            Default is 1 hour (3600000 ms).

    config MQTT_ENABLE_DEBUG_LOGS
        bool "Enable verbose MQTT debug logs"
        default n
        help
            Enable detailed debug logging for MQTT operations.
            This can help with troubleshooting but may increase
            log verbosity significantly.

    config MQTT_TASK_STACK_SIZE
        int "MQTT Task Stack Size (bytes)"
        range 4096 16384
        default 8192
        help
            Stack size for MQTT client task. Increase if you
            encounter stack overflow issues.

    config MQTT_BUFFER_SIZE
        int "MQTT Buffer Size (bytes)"
        range 1024 8192
        default 2048
        help
            Size of buffer for MQTT messages. Must be large enough
            to hold the largest expected message.

endmenu
```

## components/infrastructure/adapters/wifi_adapter/Kconfig
```kconfig
menu "WiFi Provisioning Configuration"

    config WIFI_PROV_SECURITY_1_POP
        string "Proof of Possession for WiFi Provisioning"
        default "liwaisi2025"
        help
            Password/PIN required during WiFi provisioning process.
            This is used for secure communication during the provisioning
            phase when users configure WiFi credentials.

    config WIFI_PROV_SOFTAP_SSID
        string "WiFi Provisioning SoftAP SSID"
        default "Liwaisi-Config"
        help
            Network name shown to users during provisioning.
            Users will connect to this network to configure their
            home WiFi credentials.

    config WIFI_PROV_RESET_BOOT_COUNT
        int "Boot cycles required for provisioning reset"
        range 3 10
        default 5
        help
            Number of consecutive boot cycles (power on/off) within
            the time window to trigger provisioning mode reset.
            This allows users to force the device back into
            provisioning mode by power cycling.

    config WIFI_PROV_RESET_TIME_WINDOW_MS
        int "Time window for boot cycle detection (milliseconds)"
        range 10000 60000
        default 30000
        help
            Time window in milliseconds within which consecutive
            boot cycles must occur to trigger provisioning reset.
            Default is 30 seconds.

    config WIFI_PROV_SOFTAP_CHANNEL
        int "WiFi Provisioning SoftAP Channel"
        range 1 13
        default 1
        help
            WiFi channel for the provisioning SoftAP.
            Channel 1 is generally safe for most regions.

    config WIFI_PROV_SOFTAP_MAX_STA
        int "Maximum concurrent connections to provisioning SoftAP"
        range 1 8
        default 4
        help
            Maximum number of devices that can connect simultaneously
            to the provisioning SoftAP. Usually 1-2 is sufficient.

    config WIFI_PROV_CONNECTION_MAX_RETRIES
        int "Maximum WiFi connection retries"
        range 0 20
        default 5
        help
            Maximum number of connection attempts before giving up.
            Set to 0 for unlimited retries (not recommended).

    config WIFI_PROV_ENABLE_DEBUG_LOGS
        bool "Enable verbose WiFi provisioning debug logs"
        default n
        help
            Enable detailed debug logging for WiFi provisioning.
            This can help with troubleshooting but may increase
            log verbosity significantly.

endmenu
```

## components/irrigation_controller/Kconfig
```kconfig
menu "Irrigation Controller Configuration"

    config IRRIGATION_SOIL_THRESHOLD_START
        int "Soil moisture threshold start (%)"
        default 51
        range 30 70
        help
            Irrigation starts when soil humidity average drops below this level.
            Colombian dataset optimized: 51% (typical dry soil warning)

    config IRRIGATION_SOIL_THRESHOLD_STOP
        int "Soil moisture threshold stop (%)"
        default 70
        range 50 85
        help
            Irrigation stops when all sensors reach this level.
            Colombian dataset optimized: 70-75% (healthy soil moisture)

    config IRRIGATION_SOIL_THRESHOLD_DANGER
        int "Soil moisture danger level (%)"
        default 80
        range 70 95
        help
            Immediate stop if any sensor exceeds this level (over-irrigation protection).
            Colombian dataset optimized: 80% (saturated soil - stop immediately)

    config IRRIGATION_MAX_DURATION_MINUTES
        int "Max irrigation duration (minutes)"
        default 120
        range 30 180
        help
            Safety limit - stops after this time even if humidity not reached.
            Default: 120 minutes (2 hours) - Phase 5 limit

    config IRRIGATION_MIN_INTERVAL_MINUTES
        int "Min interval between sessions (minutes)"
        default 240
        range 60 480
        help
            Prevents irrigation from restarting within N minutes.
            Default: 240 minutes (4 hours) - minimum rest period

    config IRRIGATION_VALVE_TIMEOUT_MINUTES
        int "Valve timeout alert (minutes)"
        default 40
        range 20 60
        help
            Alert to N8N if valve open longer than this time.
            Does NOT stop irrigation, only sends notification.
            Default: 40 minutes

    config IRRIGATION_OFFLINE_INTERVAL_HOURS
        int "Offline mode evaluation interval (hours)"
        default 2
        range 1 6
        help
            Check sensors every N hours when WiFi/MQTT offline.
            Default: 2 hours (normal offline mode)
            Phase 6 will add adaptive levels (30min, 15min for critical)

    config IRRIGATION_N8N_WEBHOOK_URL
        string "N8N Webhook URL"
        default "http://192.168.1.177:5678/webhook/irrigation-events"
        help
            URL where irrigation events are sent for notifications.
            Events: IRRIGATION_STARTED, IRRIGATION_STOPPED, SENSOR_ERROR, VALVE_TIMEOUT, TEMPERATURE_CRITICAL

    config IRRIGATION_ENABLE_MQTT_OVERRIDE
        bool "Enable MQTT command override"
        default y
        help
            Allow remote start/stop via MQTT commands.
            Topic: irrigation/control/{mac_address}
            Payload: "start" or "stop"

    config IRRIGATION_VALVE_LED_GPIO
        int "Valve LED GPIO (Phase 5 simulator)"
        default 21
        range 0 39
        help
            GPIO for LED simulator (Phase 5 testing).
            Phase 5: GPIO 21 (safe, not boot-related)
            Phase 6: Switch to GPIO 2 for relay module
            Default: 21 (LED simulator)

    config IRRIGATION_TEMP_CRITICAL_CELSIUS
        int "Critical temperature threshold (°C)"
        default 40
        range 30 50
        help
            Auto-stop irrigation if temperature exceeds this.
            Default: 40°C (thermal protection trigger)
            Colombian climate: rainy season 28-32°C, dry season 32-35°C, max 40°C

    config IRRIGATION_ENABLE_OFFLINE_MODE
        bool "Enable offline irrigation mode"
        default y
        help
            Allow automatic irrigation when WiFi/MQTT offline.
            Phase 5: 2-hour fixed intervals
            Phase 6: Adaptive intervals (Normal/Warning/Critical/Emergency)

    config IRRIGATION_OFFLINE_TIMEOUT_SECONDS
        int "Offline mode activation timeout (seconds)"
        default 300
        range 60 600
        help
            Switch to offline mode if no WiFi/MQTT for N seconds.
            Default: 300 seconds (5 minutes)

endmenu
```

## components/mqtt_client/Kconfig
```kconfig
menu "MQTT Client Configuration"

    config MQTT_BROKER_URI
        string "MQTT Broker URI"
        default "mqtt://mqtt.liwaisi.tech/mqtt"
        help
            MQTT broker URI used by the MQTT client.
            Examples:
            - mqtt://broker.example.com:1883
            - ws://broker.example.com:8080/mqtt
            - wss://broker.example.com:8083/mqtt

endmenu
```

## components/notification_service/Kconfig
```kconfig
menu "Notification Service Configuration"

    config NOTIFICATION_VERIFY_WIFI
        bool "Verify WiFi before sending notifications"
        default y
        help
            If enabled, notification service will verify WiFi connectivity before
            sending webhooks. This prevents wasting resources on failed HTTP requests
            when device is offline.

            If disabled, notification service will attempt to send regardless of WiFi
            status and let the HTTP client fail naturally.

    config NOTIFICATION_N8N_WEBHOOK_URL
        string "N8N Webhook URL"
        default "http://192.168.1.177:5678/webhook/irrigation-events"
        help
            HTTP endpoint URL for N8N webhooks. Configure your N8N instance URL here.

            Example: http://192.168.1.177:5678/webhook/irrigation-events

            This URL receives POST requests with irrigation event data in JSON format.

    config NOTIFICATION_N8N_API_KEY
        string "N8N API Key"
        default "d1b4873f5144c6db6c87f03109010c314a7fb9edf3052f4f478bb2d967181427"
        help
            API key for N8N webhook authentication.

            Sent as X-API-Key header in webhook requests.

            WARNING: Keep this key secure and do not commit to public repositories.
            Consider using environment-specific configurations.

    config NOTIFICATION_ENABLE_STATS
        bool "Enable notification statistics"
        default y
        help
            If enabled, notification service will track send and error counters.
            Useful for monitoring notification reliability.

endmenu
```
