## sdkconfig.defaults
```kconfig
# ESP32 Smart Irrigation System - Optimized Configuration
# Generated by optimization process - saves ~10KB memory

# Memory & Performance Optimizations
CONFIG_COMPILER_OPTIMIZATION_SIZE=y
CONFIG_COMPILER_OPTIMIZATION_ASSERTIONS_SILENT=y
CONFIG_NEWLIB_NANO_FORMAT=y

# FreeRTOS Optimizations - Disable tracing and runtime stats
# CONFIG_FREERTOS_USE_TRACE_FACILITY is not set
# CONFIG_FREERTOS_GENERATE_RUN_TIME_STATS is not set

# Stack Size Optimizations (already optimized in current config)
CONFIG_ESP_SYSTEM_EVENT_TASK_STACK_SIZE=2048
CONFIG_LWIP_TCPIP_TASK_STACK_SIZE=2048

# Logging Optimizations - Reduce default log level for production
CONFIG_LOG_DEFAULT_LEVEL_WARN=y
CONFIG_LOG_DEFAULT_LEVEL=2

# Console Optimizations - Keep essential console for debugging
CONFIG_ESP_CONSOLE_UART_DEFAULT=y
CONFIG_ESP_CONSOLE_UART_BAUDRATE=115200

# Partition Table - Single app (already optimized)
CONFIG_PARTITION_TABLE_SINGLE_APP=y

# Wi-Fi Optimizations
CONFIG_ESP_WIFI_STATIC_RX_BUFFER_NUM=4
CONFIG_ESP_WIFI_DYNAMIC_RX_BUFFER_NUM=8
CONFIG_ESP_WIFI_STATIC_TX_BUFFER_NUM=4

# HTTP Server Optimizations
CONFIG_HTTPD_MAX_REQ_HDR_LEN=1024
CONFIG_HTTPD_MAX_URI_LEN=512

# LWIP Optimizations
CONFIG_LWIP_TCP_SND_BUF_DEFAULT=8192
CONFIG_LWIP_TCP_WND_DEFAULT=8192
CONFIG_LWIP_UDP_RECVMBOX_SIZE=6

# Disable unused features to save memory
# CONFIG_ESP_WIFI_SOFTAP_SUPPORT is not set
# CONFIG_BT_ENABLED is not set
# CONFIG_ESP_COREDUMP_ENABLE is not set

# Optimized for IoT device with limited memory requirements
# These settings prioritize memory efficiency over debug features
```
